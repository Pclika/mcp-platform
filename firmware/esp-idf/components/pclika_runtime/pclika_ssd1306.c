/**
 * SPDX-License-Identifier: Apache-2.0
 * Copyright 2026 Pclika  https://pclika.com
 *
 * pclika_ssd1306.c — SSD1306 OLED 128×64 driver (I2C)
 * PCK-MMXXVI-C4A32096
 */
#include "pclika_ssd1306.h"
#include "esp_log.h"
#include <string.h>

#define TAG        "pclika_ssd1306"
#define TIMEOUT_MS 100

/* Co byte: 0x00 = command stream, 0x40 = data stream */
#define CTRL_CMD  0x00
#define CTRL_DATA 0x40

/* -------- Minimal 5×7 ASCII font (printable range 0x20–0x7E) -------- */
static const uint8_t FONT5X7[][5] = {
    {0x00,0x00,0x00,0x00,0x00}, /* ' ' */
    {0x00,0x00,0x5F,0x00,0x00}, /* '!' */
    {0x00,0x07,0x00,0x07,0x00}, /* '"' */
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    {0x10,0x08,0x08,0x10,0x08}, /* '~' */
};

/* -------- Low-level command/data helpers -------- */

static esp_err_t send_cmd(pclika_ssd1306_t *dev, uint8_t cmd)
{
    uint8_t buf[2] = {CTRL_CMD, cmd};
    return i2c_master_write_to_device(dev->port, dev->addr,
                                      buf, sizeof(buf),
                                      pdMS_TO_TICKS(TIMEOUT_MS));
}

static esp_err_t send_cmd2(pclika_ssd1306_t *dev, uint8_t c1, uint8_t c2)
{
    uint8_t buf[3] = {CTRL_CMD, c1, c2};
    return i2c_master_write_to_device(dev->port, dev->addr,
                                      buf, sizeof(buf),
                                      pdMS_TO_TICKS(TIMEOUT_MS));
}

/* -------- Init sequence (SSD1306 datasheet 10.1.1) -------- */

static const uint8_t INIT_SEQ[] = {
    CTRL_CMD,
    0xAE,       /* display off */
    0xD5, 0x80, /* clock div / osc freq */
    0xA8, 0x3F, /* multiplex ratio = 63 (64 lines) */
    0xD3, 0x00, /* display offset = 0 */
    0x40,       /* start line = 0 */
    0x8D, 0x14, /* charge pump ON */
    0x20, 0x00, /* horizontal addressing mode */
    0xA1,       /* segment remap (flip H) */
    0xC8,       /* COM scan direction (flip V) */
    0xDA, 0x12, /* COM pins config */
    0x81, 0xCF, /* contrast */
    0xD9, 0xF1, /* pre-charge period */
    0xDB, 0x40, /* VCOMH deselect */
    0xA4,       /* output from RAM */
    0xA6,       /* normal display (not inverted) */
    0xAF,       /* display on */
};

esp_err_t pclika_ssd1306_init(i2c_port_t port, uint8_t addr, pclika_ssd1306_t *out)
{
    out->port = port;
    out->addr = addr;
    memset(out->framebuf, 0, sizeof(out->framebuf));

    esp_err_t ret = i2c_master_write_to_device(port, addr,
                                                INIT_SEQ, sizeof(INIT_SEQ),
                                                pdMS_TO_TICKS(TIMEOUT_MS));
    if (ret != ESP_OK) {
        ESP_LOGE(TAG, "init failed 0x%02X: %s", addr, esp_err_to_name(ret));
        return ret;
    }
    ret = pclika_ssd1306_flush(out);
    ESP_LOGI(TAG, "init OK addr=0x%02X", addr);
    return ret;
}

void pclika_ssd1306_clear(pclika_ssd1306_t *dev)
{
    memset(dev->framebuf, 0, sizeof(dev->framebuf));
}

esp_err_t pclika_ssd1306_flush(pclika_ssd1306_t *dev)
{
    /* Set column and page address to full range */
    send_cmd2(dev, 0x21, 0);   send_cmd(dev, 127);   /* col 0–127 */
    send_cmd2(dev, 0x22, 0);   send_cmd(dev, 7);     /* page 0–7  */

    /* Send data control byte + 1024 framebuffer bytes in one I2C transaction.
     * Max I2C buffer = 1 + 1024 = 1025 bytes — within ESP-IDF default 1024+overhead. */
    static uint8_t txbuf[1 + PCLIKA_SSD1306_BUF_SIZE];
    txbuf[0] = CTRL_DATA;
    memcpy(txbuf + 1, dev->framebuf, PCLIKA_SSD1306_BUF_SIZE);
    return i2c_master_write_to_device(dev->port, dev->addr,
                                      txbuf, sizeof(txbuf),
                                      pdMS_TO_TICKS(TIMEOUT_MS));
}

void pclika_ssd1306_pixel(pclika_ssd1306_t *dev, uint8_t x, uint8_t y, bool color)
{
    if (x >= PCLIKA_SSD1306_WIDTH || y >= PCLIKA_SSD1306_HEIGHT) return;
    uint16_t idx = (y / 8) * PCLIKA_SSD1306_WIDTH + x;
    uint8_t  bit = 1 << (y % 8);
    if (color) dev->framebuf[idx] |=  bit;
    else       dev->framebuf[idx] &= ~bit;
}

void pclika_ssd1306_char(pclika_ssd1306_t *dev, uint8_t col, uint8_t row, char c)
{
    if (c < 0x20 || c > 0x7E) c = '?';
    const uint8_t *glyph = FONT5X7[c - 0x20];
    uint8_t x0 = col * 6;   /* 5 px glyph + 1 px gap */
    uint16_t base = (uint16_t)row * PCLIKA_SSD1306_WIDTH + x0;
    for (uint8_t i = 0; i < 5; i++) {
        if (base + i < PCLIKA_SSD1306_BUF_SIZE) {
            dev->framebuf[base + i] = glyph[i];
        }
    }
    if (base + 5 < PCLIKA_SSD1306_BUF_SIZE) {
        dev->framebuf[base + 5] = 0x00;  /* column gap */
    }
}

void pclika_ssd1306_string(pclika_ssd1306_t *dev, uint8_t col, uint8_t row, const char *str)
{
    uint8_t c = col, r = row;
    while (*str) {
        if (*str == '\n') { c = 0; r++; str++; continue; }
        if (c >= 21) { c = 0; r++; }
        if (r >= PCLIKA_SSD1306_PAGES) break;
        pclika_ssd1306_char(dev, c, r, *str);
        c++;
        str++;
    }
}

esp_err_t pclika_ssd1306_print(pclika_ssd1306_t *dev, const char *text)
{
    pclika_ssd1306_clear(dev);
    pclika_ssd1306_string(dev, 0, 0, text);
    return pclika_ssd1306_flush(dev);
}

esp_err_t pclika_ssd1306_display_on(pclika_ssd1306_t *dev, bool on)
{
    return send_cmd(dev, on ? 0xAF : 0xAE);
}

esp_err_t pclika_ssd1306_contrast(pclika_ssd1306_t *dev, uint8_t level)
{
    return send_cmd2(dev, 0x81, level);
}
